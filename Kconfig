## Kconfig
```kconfig
config GLOVE43TB_OS_LAYER
    bool "Activate an OS (macOS) layer depending on the selected endpoint"
    depends on !ZMK_SPLIT || ZMK_SPLIT_ROLE_CENTRAL

if GLOVE43TB_OS_LAYER

config GLOVE43TB_OS_LAYER_INDEX
    int "Index of the layer to activate"
    default 7

config GLOVE43TB_OS_LAYER_BLE_PROFILES
    hex "Bitmask of BLE profiles (BIT(n) = profile n) that activate the layer"
    default 0x18

config GLOVE43TB_OS_LAYER_USB
    bool "Activate the layer while the USB endpoint is selected"

endif

config ZMK_BEHAVIOR_BT_STEP
    bool
    default y
    depends on DT_HAS_ZMK_BEHAVIOR_BT_STEP_ENABLED && ZMK_BLE
    depends on !ZMK_SPLIT || ZMK_SPLIT_ROLE_CENTRAL
```

## dts/bindings/behaviors/zmk,behavior-bt-step.yaml
```yaml
# SPDX-License-Identifier: MIT

description: Select the next / previous BLE profile, ignoring repeats within cooldown-ms

compatible: "zmk,behavior-bt-step"

include: one_param.yaml

properties:
  cooldown-ms:
    type: int
    default: 400
```

## dts/bindings/behaviors/zmk,behavior-pointer-preset.yaml
```yaml
# SPDX-License-Identifier: MIT

description: Select the trackball pointer preset of the touch filter input processor

compatible: "zmk,behavior-pointer-preset"

include: one_param.yaml
```

## dts/bindings/input_processors/zmk,input-processor-touch-filter.yaml
```yaml
# SPDX-License-Identifier: MIT

description: Drops small movements after idle and applies a speed-dependent gain (S-curve)

compatible: "zmk,input-processor-touch-filter"

include: ip_zero_param.yaml

properties:
  idle-ms:
    type: int
    default: 150
  start-threshold:
    type: int
    default: 10
  slow-speed:
    type: int
    default: 2
    description: Speed (counts per 8 ms) at or below which the preset's minimum gain is applied
  full-speed:
    type: int
    default: 12
    description: Speed (counts per 8 ms) at or above which the gain is 100%
  min-gain-percents:
    type: array
    required: true
    description: Minimum gain (%) for each preset selectable with the pointer preset behavior
```
